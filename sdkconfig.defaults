## sdkconfig.defaults
```kconfig
# CONFIG_TINYUSB_CDC_ENABLED is not set
CONFIG_TINYUSB_CDC_COUNT=0

CONFIG_ESPTOOLPY_FLASHSIZE_4MB=y
CONFIG_ESPTOOLPY_FLASHSIZE="4MB"

CONFIG_TINYUSB_VENDOR_COUNT=0
CONFIG_TINYUSB_VENDOR_RX_BUFSIZE=0
CONFIG_TINYUSB_VENDOR_TX_BUFSIZE=0
CONFIG_TINYUSB_VENDOR_EPSIZE=64

CONFIG_TINYUSB_DEBUG_LEVEL=1

CONFIG_BT_ENABLED=y
CONFIG_BT_NIMBLE_ENABLED=y
CONFIG_BT_CONTROLLER_ENABLED=y
CONFIG_BT_NIMBLE_ROLE_PERIPHERAL=y
CONFIG_BT_NIMBLE_ROLE_BROADCASTER=y
CONFIG_BT_NIMBLE_ROLE_CENTRAL=n
CONFIG_BT_NIMBLE_ROLE_OBSERVER=n
CONFIG_BT_NIMBLE_MAX_CONNECTIONS=1
CONFIG_BT_CTRL_BLE_MAX_ACT=6
```
